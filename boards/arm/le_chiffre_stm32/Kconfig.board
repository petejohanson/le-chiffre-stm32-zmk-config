## boards/arm/le_chiffre_stm32/Kconfig.board
```kconfig
# Le Chiffre (stm32) board configuration

# Copyright (c) 2020 The ZMK Contributors
# SPDX-License-Identifier: MIT

config BOARD_LE_CHIFFRE_STM32
    bool "Le Chiffre (stm32)"
    depends on SOC_STM32F072XB
```

## config/boards/arm/le_chiffre_stm32/Kconfig.defconfig
```kconfig
# Le Chiffre (stm32) board configuration

# Copyright (c) 2020 The ZMK Contributors
# SPDX-License-Identifier: MIT

if BOARD_LE_CHIFFRE_STM32

config BOARD
    default "le_chiffre_stm32"

config ZMK_KEYBOARD_NAME
    default "Le Chiffre"

config ZMK_USB
    default y

config ZMK_KSCAN_MATRIX_POLLING
    default y

endif # BOARD_LE_CHIFFRE_STM32
```

## config/west.yml
```yaml
manifest:
  remotes:
    - name: zmkfirmware
      url-base: https://github.com/zmkfirmware
    - name: petejohanson
      url-base: https://github.com/petejohanson
  projects:
    - name: zmk
      remote: zmkfirmware
      revision: v0.3
      import: app/west.yml
  self:
    path: config
```
