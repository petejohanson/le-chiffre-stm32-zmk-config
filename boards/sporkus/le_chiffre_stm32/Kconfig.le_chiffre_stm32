## boards/sporkus/le_chiffre_stm32/Kconfig.le_chiffre_stm32
```kconfig
# Copyright (c) 2020 The ZMK Contributors
# SPDX-License-Identifier: Apache-2.0

config BOARD_LE_CHIFFRE_STM32
	select SOC_STM32F072XB
	imply RETAINED_MEM
	imply RETENTION
	imply RETENTION_BOOT_MODE
	imply STM32_BOOTLOADER
```

## boards/sporkus/le_chiffre_stm32/board.yml
```yaml
board:
  name: le_chiffre_stm32
  vendor: sporkus
  socs:
    - name: stm32f072xb
```
